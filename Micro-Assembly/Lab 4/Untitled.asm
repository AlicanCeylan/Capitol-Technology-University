#include <p18f8722.inc>
CLRF TRISD, 0
CLRF PORTD, 0
MOVLW 0x3F
MOVWF PORTD, 0
CALL DELAY
MOVLW 0x06
MOVWF PORTD, 0
CALL DELAY
MOVLW 0x5b
MOVWF PORTD, 0
CALL DELAY
MOVLW 0x4f
MOVWF PORTD, 0
CALL DELAY
MOVLW 0x66
MOVWF PORTD, 0
CALL DELAY
MOVLW 0x6d
MOVWF PORTD, 0
CALL DELAY
MOVLW 0x7d
MOVWF PORTD, 0
CALL DELAY
MOVLW 0x07
MOVWF PORTD, 0
CALL DELAY
MOVLW 0x7f
MOVWF PORTD, 0
CALL DELAY
MOVLW 0x6f
MOVWF PORTD, 0

DELAY
Counter1 EQU 0X0C
Counter2 EQU 0X0D
Counter3 EQU 0X0E

MOVLW 0Xb5
MOVWF Counter1
MOVLW 0Xaf
MOVWF Counter2
MOVLW 0X0d
MOVWF Counter3
LOOP 
DECFSZ Counter1, 1
GOTO LOOP
DECFSZ Counter2, 1
GOTO LOOP
DECFSZ Counter3, 1
GOTO LOOP
RETURN


end