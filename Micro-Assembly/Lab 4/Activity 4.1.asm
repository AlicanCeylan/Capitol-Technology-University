#include <p18f8722.inc>
CLRF TRISD, 0
CLRF PORTD, 0
MOVLW 0xC0
MOVWF PORTD, 0
CALL DELAY
MOVLW 0xF9
MOVWF PORTD, 0
CALL DELAY
MOVLW 0xA4
MOVWF PORTD, 0
CALL DELAY
MOVLW 0xB0
MOVWF PORTD, 0
CALL DELAY
MOVLW 0x99
MOVWF PORTD, 0
CALL DELAY
MOVLW 0x92
MOVWF PORTD, 0
CALL DELAY
MOVLW 0x82
MOVWF PORTD, 0
CALL DELAY
MOVLW 0xF8
MOVWF PORTD, 0
CALL DELAY
MOVLW 0x80
MOVWF PORTD, 0
CALL DELAY
MOVLW 0x90
MOVWF PORTD, 0

DELAY
Counter1 EQU 0X0C
Counter2 EQU 0X0D
Counter3 EQU 0X0E

MOVLW 0Xb5
MOVWF Counter1
MOVLW 0Xaf
MOVWF Counter2
MOVLW 0X0d
MOVWF Counter3
LOOP 
DECFSZ Counter1, 1
GOTO LOOP
DECFSZ Counter2, 1
GOTO LOOP
DECFSZ Counter3, 1
GOTO LOOP
RETURN


end